## main/Kconfig.projbuild
```kconfig
menu "LCD Configuration"
    choice LCD_MODULE
        prompt "LCD Module"
        default WAVESHARE_1_47INCH_TOUCH_LCD
        help
            Select the corresponding Waveshare LCD Module for your board.
            - 1.46inch Touch LCD
            - 1.47inch Touch LCD(default)
            - 1.85inch Touch LCD
            - 2inch Touch LCD
            - 2.8inch Touch LCD 
    config WAVESHARE_1_46INCH_TOUCH_LCD
        bool "1.46inch Touch LCD"
        help
            The product is not yet available for sale
    config WAVESHARE_1_47INCH_TOUCH_LCD
        bool "1.47inch Touch LCD"
        help
            https://www.waveshare.net/shop/1.47inch-Touch-LCD.htm
    config WAVESHARE_1_85INCH_TOUCH_LCD
        bool "1.85inch Touch LCD"
        help
            The product is not yet available for sale
    config WAVESHARE_2INCH_TOUCH_LCD
        bool "2inch Touch LCD"
        help
            https://www.waveshare.net/shop/2.8inch-Capacitive-Touch-LCD.htm
    config WAVESHARE_2_8INCH_TOUCH_LCD
        bool "2.8inch Touch LCD"
        help
            https://www.waveshare.net/shop/2.8inch-Capacitive-Touch-LCD.htm

    endchoice

    config Round_LCD_screen
        bool "This LCD is circular"
        default y
        depends on WAVESHARE_1_85INCH_TOUCH_LCD || WAVESHARE_1_46INCH_TOUCH_LCD
        help
            This LCD is circular

    choice DISPLAY_ROTATION_ANGLE
        prompt "Display Angle"
        default EXAMPLE_DISPLAY_ROTATION_90_DEGREE
        help
            Set the screen rotation Angle(On by default).
    
    config EXAMPLE_DISPLAY_ROTATION_0_DEGREE    
        bool "Set the screen to rotate 0 degrees"
        help
            Set the screen to rotate 0 degrees
    config EXAMPLE_DISPLAY_ROTATION_90_DEGREE    
        bool "Set the screen to rotate 90 degrees"
        help
            Set the screen to rotate 90 degrees 
    config EXAMPLE_DISPLAY_ROTATION_180_DEGREE  
        bool "Set the screen to rotate 180 degrees"
        help
            Set the screen to rotate 180 degrees 
    config EXAMPLE_DISPLAY_ROTATION_270_DEGREE  
        bool "Set the screen to rotate 270 degrees"
        help
            Set the screen to rotate 270 degrees
    endchoice

    choice LVGL_CONFIGURATION
        prompt "LVGL configuration"
        depends on WAVESHARE_1_85INCH_TOUCH_LCD || WAVESHARE_1_46INCH_TOUCH_LCD || WAVESHARE_1_47INCH_TOUCH_LCD
        default LV_COLOR_16_SWAP
        help
            Swap the 2 bytes of RGB565 color. Useful if the display has an 8-bit interface.
            - 2.8inch Touch LCD (Disable)
    
    config LV_COLOR_16_SWAP
        bool "Swap the 2 bytes of RGB565 color"
        help
            Swap the 2 bytes of RGB565 color
    endchoice
    
    # choice AUDIO_BOARD
    #     prompt "Audio Board"
    #     default ESP32_S3_KORVO2_V3_BOARD
    #     help
    #         Set compatibility board(On by default).
    
    # config ESP32_S3_KORVO2_V3_BOARD    # CONFIG_ESP32_S3_BOX_BOARD / ESP32_S3_BOX_3_BOARD / ESP32_S3_KORVO2_V3_BOARD
    #     bool "Set compatibility board"
    #     default y
    #     help
    #         Set compatibility board
    # endchoice
    
endmenu
```
